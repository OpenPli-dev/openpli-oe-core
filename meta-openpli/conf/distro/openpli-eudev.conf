## meta-openpli/conf/distro/openpli-eudev.conf
```bitbake
#@TYPE: Distribution
#@NAME: OpenPLi
#@DESCRIPTION: Embedded Linux Distribution Configuration for STB's

require openpli.conf

DISTRO_VERSION = "home-eudev"
VIRTUAL-RUNTIME_dev_manager = "eudev"
```
